## sdkconfig.defaults
```kconfig
# Bluetooth Classic (required for Joy-Con HID)
CONFIG_BT_ENABLED=y
CONFIG_BT_CLASSIC_ENABLED=y
CONFIG_BT_HID_HOST_ENABLED=y
CONFIG_BT_BLUEDROID_ENABLED=y
CONFIG_BT_BLE_ENABLED=n

# Increase BT stack sizes for HID host
CONFIG_BT_BTC_TASK_STACK_SIZE=8192
CONFIG_BT_BTU_TASK_STACK_SIZE=8192

# UART for VESC
CONFIG_UART_ISR_IN_IRAM=y

# FreeRTOS
CONFIG_FREERTOS_HZ=1000

# Logging
CONFIG_LOG_DEFAULT_LEVEL_INFO=y

# Disable unused radios
CONFIG_ESP_WIFI_ENABLED=n
```
